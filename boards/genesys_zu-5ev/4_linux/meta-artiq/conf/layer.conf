## boards/genesys_zu-5ev/4_linux/meta-artiq/conf/layer.conf
```bitbake
BBPATH .= ":${LAYERDIR}"

BBFILES += "${LAYERDIR}/recipes-*/*/*.bb \
            ${LAYERDIR}/recipes-*/*/*.bbappend"

BBFILE_COLLECTIONS += "meta-artiq"
BBFILE_PATTERN_meta-artiq = "^${LAYERDIR}/"
BBFILE_PRIORITY_meta-artiq = "6"

LAYERDEPENDS_meta-artiq = "core"
LAYERSERIES_COMPAT_meta-artiq = "scarthgap"
```

## common/petalinux/meta-petalinux-artiq/conf/distro/petalinux-artiq.conf
```bitbake
require conf/distro/petalinux.conf

VIRTUAL-RUNTIME_base-utils = "packagegroup-core-full-cmdline"
VIRTUAL-RUNTIME_base-utils-hwclock = "util-linux-hwclock"
VIRTUAL-RUNTIME_base-utils-syslog = ""
VIRTUAL-RUNTIME_login_manager = "shadow-base"

PACKAGECONFIG:remove:pn-vim = "x11 gtkgui"

# SEE: meta-petalinux/conf/distro/petalinux.conf
EXTRA_USERS_PARAMS = " \
    useradd -p '' -- petalinux ; \
    usermod -a -Gadm,sudo,audio,video,input,plugdev,dialout -- petalinux ; \
"

# SEE: meta-petalinux/classes/plnx-useradd-sudoers.bbclass
EXTRA_USERS_SUDOERS = " \
    %sudo ALL=(ALL:ALL) ALL ; \
"
```

## common/petalinux/meta-petalinux-artiq/conf/layer.conf
```bitbake
BBPATH .= ":${LAYERDIR}"

BBFILES += "${LAYERDIR}/recipes-*/*/*.bb \
            ${LAYERDIR}/recipes-*/*/*.bbappend"

BBFILE_COLLECTIONS += "petalinux-artiq"
BBFILE_PATTERN_petalinux-artiq = "^${LAYERDIR}/"
BBFILE_PRIORITY_petalinux-artiq = "6"

LAYERDEPENDS_petalinux-artiq = "core"
LAYERSERIES_COMPAT_petalinux-artiq = "scarthgap"
```

## common/petalinux/meta-petalinux-artiq/conf/machine/zynqmp-artiq.conf
```bitbake
require conf/machine/zynqmp-generic.conf

INITRAMFS_IMAGE = "petalinux-initramfs-image-artiq"
INITRAMFS_FSTYPES = "cpio.gz.u-boot"
RAMDISK_IMAGE = "${INITRAMFS_IMAGE}-${MACHINE}.${INITRAMFS_FSTYPES}"
KERNEL_ROOT_RAMDISK = "root=/dev/\${bootdev}2"
KERNEL_COMMAND_APPEND = "panic=5 \${extra_bootargs}"
IMAGE_BOOT_FILES += "${RAMDISK_IMAGE}"
IMAGE_FSTYPES += "wic"
WKS_FILES = "petalinux-artiq-sd.wks"
```

## common/petalinux/meta-petalinux-artiq/wic/petalinux-artiq-sd.wks
```
part  /boot      --source rootfs --change-directory=boot  --fixed-size=128M  --fstype=vfat  --label boot  --active  --align 4  --fsoptions=ro,noatime  --use-uuid
part  /          --source rootfs --exclude-path=boot/                        --fstype=ext4  --label root            --align 4  --extra-space=16M
part  /mnt/data                                           --fixed-size=128M  --fstype=ext4  --label data            --align 4  --fsoptions=noatime     --use-uuid
```

## common/yocto/meta-artiq-xilinx/conf/layer.conf
```bitbake
BBPATH .= ":${LAYERDIR}"

BBFILES += "${LAYERDIR}/recipes-*/*/*.bb \
            ${LAYERDIR}/recipes-*/*/*.bbappend"

BBFILE_COLLECTIONS += "artiq-xilinx"
BBFILE_PATTERN_artiq-xilinx = "^${LAYERDIR}/"
BBFILE_PRIORITY_artiq-xilinx = "6"

LAYERDEPENDS_artiq-xilinx = "core"
LAYERSERIES_COMPAT_artiq-xilinx = "scarthgap"
```

## common/yocto/meta-artiq-xilinx/conf/machine/zynqmp-artiq.conf
```bitbake
require conf/machine/zynqmp-generic.conf

INITRAMFS_IMAGE = "artiqlinux-initramfs-image"
INITRAMFS_FSTYPES = "cpio.gz.u-boot"
RAMDISK_IMAGE = "${INITRAMFS_IMAGE}-${MACHINE}.${INITRAMFS_FSTYPES}"
KERNEL_ROOT_RAMDISK = "root=/dev/\${bootdev}2"
KERNEL_COMMAND_APPEND = "panic=5"
IMAGE_BOOT_FILES += "${RAMDISK_IMAGE}"
IMAGE_FSTYPES += "wic"
```
